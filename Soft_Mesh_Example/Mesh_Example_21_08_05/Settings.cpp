#include "Settings.h"
//--------------------------------------------------------------------------------------------------------------------------------
SettingsClass Settings;
//--------------------------------------------------------------------------------------------------------------------------------
SettingsClass::SettingsClass()
{
  adc20_9_O2Value = 0;
}
//--------------------------------------------------------------------------------------------------------------------------------
void SettingsClass::Set20_9_O2Value(uint16_t val)
{
  adc20_9_O2Value = val; 
}
//--------------------------------------------------------------------------------------------------------------------------------
uint16_t SettingsClass::Get20_9_O2Value()
{
  return adc20_9_O2Value;
}
//--------------------------------------------------------------------------------------------------------------------------------
uint16_t SettingsClass::GetMeasureTime()
{
  uint16_t result;
  if(!read("mtime", "mtimecrc", result))
  {
    result = 60; // по умолчанию 60 секунд на изменение
  }

  if(result < 1)
  {
    result = 60;
  }

  return result;
}
//--------------------------------------------------------------------------------------------------------------------------------
void SettingsClass::SetMeasureTime(uint16_t val)
{
  write("mtime", "mtimecrc", val); 
}
//--------------------------------------------------------------------------------------------------------------------------------
TFTCalibrationData SettingsClass::GetCalibrationData()
{
  TFTCalibrationData result;

  if(!read("cal1", "calcrc", result))
  {
    result.isValid = false;
    return result;
  }
  
  result.isValid = true;
  return result;  
}
//--------------------------------------------------------------------------------------------------------------------------------
void SettingsClass::SetCalibrationData(TFTCalibrationData& data)
{
  data.isValid = true;
  write("cal1", "calcrc", data); 
}
//--------------------------------------------------------------------------------------------------------------------------------
/*
int SettingsClass::SettingsClass::GetControllerID()
{
  int result;
  if(!read("cid", "cidcrc", result))
  {
    result = 0;
  }

  return result;
}
//--------------------------------------------------------------------------------------------------------------------------------
void SettingsClass::SetControllerID(int value)
{
  
  write("cid", "cidcrc", value);
  
}
*/
//--------------------------------------------------------------------------------------------------------------------------------
void SettingsClass::setup()
{
  prefs.begin("storage5");
}
//--------------------------------------------------------------------------------------------------------------------------------

